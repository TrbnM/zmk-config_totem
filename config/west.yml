## config/west.yml
```yaml
manifest:
  remotes:
    - name: zmkfirmware
      url-base: https://github.com/zmkfirmware
  projects:
    - name: zmk
      remote: zmkfirmware
      revision: main
      import: app/west.yml
    # Füge dieses Projekt hinzu:
    - name: zmk-hardware
      remote: zmkfirmware
      revision: main
  self:
    path: config
```
